## board/adapteva/Kconfig
```kconfig
if TARGET_ADAPTEVA_PARALLELLA

config SYS_BOARD
	default "parallella"

config SYS_VENDOR
	default "adapteva"

config SYS_SOC
	default "zynq"

config SYS_CONFIG_NAME
	default "adapteva_parallella"

endif
```

## board/adapteva/parallella/Kconfig
```kconfig
if ARCH_ZYNQ

config TARGET_ADAPTEVA_PARALLELLA
        bool "Support Adapteva Parallella"
        default n
        help
          Enable extra board initialization code to
          support Adapteva Parallella boards.

config SYS_BOARD
	default "parallella"

config SYS_VENDOR
	default "adapteva"

config SYS_SOC
	default "zynq"

config SYS_CONFIG_NAME
	default "adapteva_parallella"

endif
```

## configs/adapteva_parallella_defconfig
```kconfig
# We need I2C to configure the PMIC. I2C is hooked up via EMIO so we need to
# have the PL initialized *before* U-BOOT is started. So no SPL for us :(
CONFIG_SPL=n
CONFIG_ARM=y
CONFIG_ZYNQ=y
CONFIG_TARGET_ADAPTEVA_PARALLELLA=y
CONFIG_OF_CONTROL=n
CONFIG_DEFAULT_DEVICE_TREE="zynq-parallella"
```
